## drivers/misc/mediatek/sensors-1.0/sar/Kconfig
```kconfig
config MTK_SAR_SX9328
	bool "SX9328 for MediaTek package"
	default n
	help
      It support different type sensor
	  in this platform. If this option
	  is set, it will support sar sensor 
	  sx9382.
```

## sound/soc/codecs/aw8838/Kconfig
```kconfig
#
# SoC audio configuration
#

config SND_SMARTPA_AW8838
	tristate "SoC Audio for awinic aw8838 series"
	depends on I2C
	help
		This option enables support for aw8838 series Smart PA.
```
